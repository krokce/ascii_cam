## br2-external/configs/asciicam_defconfig
```kconfig
BR2_arm=y
BR2_arm1176jzf_s=y
BR2_TOOLCHAIN_EXTERNAL=y
BR2_TOOLCHAIN_EXTERNAL_BOOTLIN_ARMV6_EABIHF_GLIBC_STABLE=y
BR2_GLOBAL_PATCH_DIR="board/raspberrypi/patches"
BR2_DOWNLOAD_FORCE_CHECK_HASHES=y
BR2_TARGET_GENERIC_HOSTNAME="asciicam"
BR2_TARGET_GENERIC_ISSUE="ASCII camera appliance"
# BR2_TARGET_GENERIC_REMOUNT_ROOTFS_RW is not set
# BR2_TARGET_GENERIC_GETTY is not set
BR2_ROOTFS_OVERLAY="$(BR2_EXTERNAL_ASCIICAM_PATH)/board/asciicam/rootfs-overlay"
BR2_ROOTFS_POST_BUILD_SCRIPT="$(BR2_EXTERNAL_ASCIICAM_PATH)/board/asciicam/post-build.sh"
BR2_ROOTFS_POST_IMAGE_SCRIPT="$(BR2_EXTERNAL_ASCIICAM_PATH)/board/asciicam/post-image.sh"
BR2_LINUX_KERNEL=y
BR2_LINUX_KERNEL_CUSTOM_TARBALL=y
BR2_LINUX_KERNEL_CUSTOM_TARBALL_LOCATION="$(call github,raspberrypi,linux,21b410140c47ffab5668399f6f143c7d7b935c8b)/linux-21b410140c47ffab5668399f6f143c7d7b935c8b.tar.gz"
BR2_LINUX_KERNEL_DEFCONFIG="bcmrpi"
BR2_LINUX_KERNEL_CONFIG_FRAGMENT_FILES="$(BR2_EXTERNAL_ASCIICAM_PATH)/board/asciicam/linux.fragment"
BR2_LINUX_KERNEL_DTS_SUPPORT=y
BR2_LINUX_KERNEL_INTREE_DTS_NAME="broadcom/bcm2708-rpi-zero-w"
BR2_LINUX_KERNEL_NEEDS_HOST_OPENSSL=y
BR2_PACKAGE_BUSYBOX_SHOW_OTHERS=y
# xz is required: the kernel modules are xz-compressed, and modprobe
# can only load them when kmod is built with xz support.
BR2_PACKAGE_XZ=y
BR2_PACKAGE_RPI_FIRMWARE=y
BR2_PACKAGE_RPI_FIRMWARE_BOOTCODE_BIN=y
BR2_PACKAGE_RPI_FIRMWARE_VARIANT_PI_X=y
BR2_PACKAGE_RPI_FIRMWARE_CONFIG_FILE="$(BR2_EXTERNAL_ASCIICAM_PATH)/board/asciicam/config.txt"
BR2_PACKAGE_RPI_FIRMWARE_CMDLINE_FILE="$(BR2_EXTERNAL_ASCIICAM_PATH)/board/asciicam/cmdline.txt"
BR2_PACKAGE_RPI_FIRMWARE_INSTALL_DTB_OVERLAYS=y
BR2_PACKAGE_KMOD=y
BR2_PACKAGE_KMOD_TOOLS=y
BR2_PACKAGE_ASCIICAM=y
# Wi-Fi and SSH are always built in and are switched on in settings.txt.
# The serial console is a build option: change the next line to
# BR2_PACKAGE_ASCIICAM_SERIAL_CONSOLE=y and rebuild to switch it on.
# BR2_PACKAGE_ASCIICAM_SERIAL_CONSOLE is not set
BR2_TARGET_ROOTFS_EXT2=y
BR2_TARGET_ROOTFS_EXT2_4=y
BR2_TARGET_ROOTFS_EXT2_SIZE="96M"
# BR2_TARGET_ROOTFS_TAR is not set
BR2_PACKAGE_HOST_DOSFSTOOLS=y
BR2_PACKAGE_HOST_GENIMAGE=y
BR2_PACKAGE_HOST_KMOD_XZ=y
BR2_PACKAGE_HOST_MTOOLS=y
```

## br2-external/package/asciicam/Config.in
```kconfig
config BR2_PACKAGE_ASCIICAM
	bool "asciicam"
	depends on BR2_USE_WCHAR # dosfstools
	select BR2_PACKAGE_DOSFSTOOLS
	select BR2_PACKAGE_DOSFSTOOLS_FSCK_FAT
	select BR2_PACKAGE_DOSFSTOOLS_MKFS_FAT
	select BR2_PACKAGE_UTIL_LINUX
	select BR2_PACKAGE_UTIL_LINUX_BINARIES
	select BR2_PACKAGE_UTIL_LINUX_PARTX
	select BR2_PACKAGE_WPA_SUPPLICANT
	select BR2_PACKAGE_WPA_SUPPLICANT_NL80211
	select BR2_PACKAGE_BRCMFMAC_SDIO_FIRMWARE_RPI
	select BR2_PACKAGE_BRCMFMAC_SDIO_FIRMWARE_RPI_WIFI
	select BR2_PACKAGE_DROPBEAR
	select BR2_PACKAGE_MDNSD # the name asciicam.local on the network
	help
	  The camera to MDA text appliance program, its init scripts
	  and the first-boot REC partition grower. Wi-Fi and SSH are
	  always included but stay off unless settings.txt on REC
	  says wifi = on or ssh = on.

if BR2_PACKAGE_ASCIICAM

config BR2_PACKAGE_ASCIICAM_SERIAL_CONSOLE
	bool "debug: serial console on GPIO 14 and 15"
	help
	  Off by default. When on, a login prompt runs on the UART at
	  115200 baud, on header pin 8 (transmit, GPIO 14) and pin 10
	  (receive, GPIO 15). These pins are not used by the display.

endif
```
